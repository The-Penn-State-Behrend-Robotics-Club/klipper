## src/atsamd/Kconfig
```kconfig
# Kconfig settings for Atmel SAMD processors

if MACH_ATSAMD

config ATSAMD_SELECT
    bool
    default y
    select HAVE_GPIO
    select HAVE_GPIO_ADC
    select HAVE_GPIO_USART
    select HAVE_GPIO_I2C
    select HAVE_GPIO_SPI
    select HAVE_GPIO_HARD_PWM
    select HAVE_GPIO_BITBANGING
    select HAVE_STRICT_TIMING
    select HAVE_CHIPID
    select HAVE_STEPPER_BOTH_EDGE
    select HAVE_BOOTLOADER_REQUEST

config HAVE_SERCOM
    depends on HAVE_GPIO_I2C || HAVE_GPIO_SPI
    bool
    default y

config BOARD_DIRECTORY
    string
    default "atsamd"

choice
    prompt "Processor model"
    config MACH_SAMC21G18
        bool "SAMC21G18 (Duet 3 Toolboard 1LC)"
        select MACH_SAMC21
    config MACH_SAMD21G18
        bool "SAMD21G18 (Arduino Zero)"
        select MACH_SAMD21
    config MACH_SAMD21E18
        bool "SAMD21E18 (Adafruit Trinket M0)"
        select MACH_SAMD21
    config MACH_SAMD21J18
        bool "SAMD21J18 (ReprapWorld Minitronics v2)"
        select MACH_SAMD21
    config MACH_SAMD21E15
        bool "SAMD21E15"
        select MACH_SAMD21
    config MACH_SAMD51G19
        bool "SAMD51G19 (Adafruit ItsyBitsy M4)"
        select MACH_SAMD51
    config MACH_SAMD51J19
        bool "SAMD51J19 (Adafruit Metro M4)"
        select MACH_SAMD51
    config MACH_SAMD51N19
        bool "SAMD51N19"
        select MACH_SAMD51
    config MACH_SAMD51P20
        bool "SAMD51P20 (Adafruit Grand Central)"
        select MACH_SAMD51
    config MACH_SAME51J19
        bool "SAME51J19 (Adafruit Feather M4 CAN)"
        select MACH_SAME51
    config MACH_SAME54P20
        bool "SAME54P20"
        select MACH_SAME54
endchoice

config MACH_SAMX2
    bool
config MACH_SAMC21
    bool
    select MACH_SAMX2
config MACH_SAMD21
    bool
    select MACH_SAMX2
config MACH_SAMX5
    bool
config MACH_SAMD51
    bool
    select MACH_SAMX5
config MACH_SAME51
    bool
    select MACH_SAMX5
config MACH_SAME54
    bool
    select MACH_SAMX5
config HAVE_SAMD_CANBUS
    bool
    default y if MACH_SAMC21 || MACH_SAME51 || MACH_SAME54
config HAVE_SAMD_USB
    bool
    default n if MACH_SAMC21G18
    default y

config MCU
    string
    default "samc21g18a" if MACH_SAMC21G18
    default "samd21g18a" if MACH_SAMD21G18
    default "samd21e18a" if MACH_SAMD21E18
    default "samd21j18a" if MACH_SAMD21J18
    default "samd21e15a" if MACH_SAMD21E15
    default "samd51g19a" if MACH_SAMD51G19
    default "samd51j19a" if MACH_SAMD51J19
    default "samd51n19a" if MACH_SAMD51N19
    default "samd51p20a" if MACH_SAMD51P20
    default "same51j19a" if MACH_SAME51J19
    default "same54p20a" if MACH_SAME54P20

config FLASH_SIZE
    hex
    default 0x8000 if MACH_SAMD21E15
    default 0x40000 if MACH_SAMC21G18 || MACH_SAMD21G18 || MACH_SAMD21E18 || MACH_SAMD21J18
    default 0x80000 if MACH_SAMD51G19 || MACH_SAMD51J19 || MACH_SAMD51N19 || MACH_SAME51J19
    default 0x100000 if MACH_SAMD51P20 || MACH_SAME54P20

config FLASH_BOOT_ADDRESS
    hex
    default 0x0

config RAM_START
    hex
    default 0x20000000

config RAM_SIZE
    hex
    default 0x1000 if MACH_SAMD21E15
    default 0x8000 if MACH_SAMC21G18 ||  MACH_SAMD21G18 || MACH_SAMD21E18 || MACH_SAMD21J18
    default 0x30000 if MACH_SAMD51G19 || MACH_SAMD51J19 || MACH_SAMD51N19 || MACH_SAME51J19
    default 0x40000 if MACH_SAMD51P20 || MACH_SAME54P20

config SERCOMS
    int  # 4 for E's, 6 for G's and J's, 8 for N's and P's
    default 4 if MACH_SAMD21E15 || MACH_SAMD21E18
    default 6 if MACH_SAMD21G18 || MACH_SAMD51G19 || MACH_SAMD51J19 || MACH_SAME51J19
    default 8 if MACH_SAMD51N19 || MACH_SAMD51P20 || MACH_SAME54P20

config STACK_SIZE
    int
    default 512


######################################################################
# Bootloader
######################################################################

choice
    prompt "Bootloader offset"
    config SAMD_FLASH_START_2000
        depends on MACH_SAMD21
        bool "8KiB bootloader (Arduino Zero)"
    config SAMD_FLASH_START_4000
        bool "16KiB bootloader (Arduino M0, Duet 3 Bootloader)"
    config SAMD_FLASH_START_0000
        bool "No bootloader"
endchoice
config FLASH_APPLICATION_ADDRESS
    hex
    default 0x4000 if SAMD_FLASH_START_4000
    default 0x2000 if SAMD_FLASH_START_2000
    default 0x0000


######################################################################
# Clock
######################################################################

choice
    prompt "Clock Reference"
    config CLOCK_REF_X32K
        bool "32.768Khz crystal" if !MACH_SAMC21
    config CLOCK_REF_X12M
        bool "12Mhz crystal" if MACH_SAMC21
    config CLOCK_REF_X25M
        bool "25Mhz crystal" if MACH_SAMC21 || MACH_SAMX5
    config CLOCK_REF_INTERNAL
        bool "Internal clock" if !MACH_SAMC21
endchoice

choice
    depends on MACH_SAMX5 && LOW_LEVEL_OPTIONS
    prompt "Processor speed"
    config SAMD51_FREQ_120
        bool "120 MHz (standard)"
    config SAMD51_FREQ_150
        bool "150 MHz (overclock)"
    config SAMD51_FREQ_180
        bool "180 MHz (overclock)"
    config SAMD51_FREQ_200
        bool "200 MHz (overclock)"
endchoice

config CLOCK_FREQ
    int
    default 48000000 if MACH_SAMX2
    default 150000000 if SAMD51_FREQ_150
    default 180000000 if SAMD51_FREQ_180
    default 200000000 if SAMD51_FREQ_200
    default 120000000 if MACH_SAMX5


######################################################################
# Communication inteface
######################################################################

choice
    prompt "Communication interface"
    config ATSAMD_USB
        bool "USB"
        depends on HAVE_SAMD_USB
        select USBSERIAL
    config ATSAMD_SERIAL_SERCOM0_CUSTOM
        bool "Serial (on SERCOM0)" if LOW_LEVEL_OPTIONS
        depends on !MACH_SAMC21
        select SERIAL
    config ATSAMD_SERIAL_SERCOM0_DEFAULT
        bool "Serial (on SERCOM0 PA10/PA11)" if !LOW_LEVEL_OPTIONS
        depends on MACH_SAMD21
        select SERIAL
    config ATSAMD_SERIAL_SERCOM1
        bool "Serial (on SERCOM1)" if LOW_LEVEL_OPTIONS
        depends on !MACH_SAMC21
        select SERIAL
    config ATSAMD_SERIAL_SERCOM2
        bool "Serial (on SERCOM2)" if LOW_LEVEL_OPTIONS
        depends on !MACH_SAMC21
        select SERIAL
    config ATSAMD_SERIAL_SERCOM3_CUSTOM
        bool "Serial (on SERCOM3)" if LOW_LEVEL_OPTIONS
        depends on !MACH_SAMC21
        select SERIAL
    config ATSAMD_SERIAL_SERCOM3_DEFAULT
        bool "Serial (on SERCOM3 PA17/PA16)" if !LOW_LEVEL_OPTIONS
        depends on MACH_SAMX5
        select Serial
    config ATSAMD_SERIAL_SERCOM4
        bool "Serial (on SERCOM4)" if LOW_LEVEL_OPTIONS
        depends on SERCOMS > 4
        select SERIAL
    config ATSAMD_SERIAL_SERCOM5_CUSTOM
        bool "Serial (on SERCOM5)" if LOW_LEVEL_OPTIONS
        depends on  SERCOMS > 5
        select SERIAL
    config ATSAMD_SERIAL_SERCOM5_DEFAULT
        bool "Serial (on SERCOM5 PB16/PB17)" if !LOW_LEVEL_OPTIONS
        depends on SERCOMS > 5 && MACH_SAMX5
        select SERIAL
    config ATSAMD_SERIAL_SERCOM6
        bool "Serial (on SERCOM6)" if LOW_LEVEL_OPTIONS
        depends on SERCOMS > 6
        select SERIAL
    config ATSAMD_SERIAL_SERCOM7
        bool "Serial (on SERCOM7)" if LOW_LEVEL_OPTIONS
        depends on SERCOMS > 7
        select SERIAL
    config ATSAMD_MMENU_CANBUS_PA23_PA22
        bool "CAN bus (on PA23/PA22)"
        depends on HAVE_SAMD_CANBUS
        select CANSERIAL
    config ATSAMD_MMENU_CANBUS_PA25_PA24
        bool "CAN bus (on PA25/PA24)"
        depends on HAVE_SAMD_CANBUS
        select CANSERIAL
    config ATSAMD_MMENU_CANBUS_PB11_PB10
        bool "CAN bus (on PB11/PB10)"
        depends on HAVE_SAMD_CANBUS && MACH_SAMC21
        select CANSERIAL
    config ATSAMD_MMENU_CANBUS_PB13_PB12
        bool "CAN bus (on PB13/PB12)"
        depends on HAVE_SAMD_CANBUS && !MACH_SAMC21
        select CANSERIAL
    config ATSAMD_MMENU_CANBUS_PB15_PB14
        bool "CAN bus (on PB15/PB14)"
        depends on HAVE_SAMD_CANBUS
        select CANSERIAL
    config ATSAMD_USBCANBUS
        bool "USB to CAN bus bridge"
        depends on HAVE_SAMD_CANBUS && HAVE_SAMD_USB
        select USBCANBUS
endchoice

config ATSAMD_SERIAL_SERCOM0
    bool
    default ATSAMD_SERIAL_SERCOM0_CUSTOM || ATSAMD_SERIAL_SERCOM0_DEFAULT
config ATSAMD_SERIAL_SERCOM3
    bool
    default ATSAMD_SERIAL_SERCOM3_CUSTOM || ATSAMD_SERIAL_SERCOM3_DEFAULT
config ATSAMD_SERIAL_SERCOM5
    bool
    default ATSAMD_SERIAL_SERCOM5_CUSTOM || ATSAMD_SERIAL_SERCOM5_DEFAULT

choice
    prompt "Serial TX Pin" if LOW_LEVEL_OPTIONS && SERIAL
    default ATSAMD_SERIAL_SERCOM0_TX_A10 if ATSAMD_SERIAL_SERCOM0
    default ATSAMD_SERIAL_SERCOM3_TX_A17 if ATSAMD_SERIAL_SERCOM3
    default ATSAMD_SERIAL_SERCOM5_TX_B16 if ATSAMD_SERIAL_SERCOM5
    if MACH_SAMD21
    config ATSAMD_SERIAL_SERCOM0_TX_A8
        bool "TX on A8" if ATSAMD_SERIAL_SERCOM0
    config ATSAMD_SERIAL_SERCOM0_TX_A10
        bool "TX on A10" if ATSAMD_SERIAL_SERCOM0
    config ATSAMD_SERIAL_SERCOM0_TX_A4
        bool "TX on A4" if ATSAMD_SERIAL_SERCOM0
    config ATSAMD_SERIAL_SERCOM0_TX_A6
        bool "TX on A6" if ATSAMD_SERIAL_SERCOM0
    config ATSAMD_SERIAL_SERCOM1_TX_A16
        bool "TX on A16" if ATSAMD_SERIAL_SERCOM1
    config ATSAMD_SERIAL_SERCOM1_TX_A18
        bool "TX on A18" if ATSAMD_SERIAL_SERCOM1
    config ATSAMD_SERIAL_SERCOM1_TX_A0
        bool "TX on A0" if ATSAMD_SERIAL_SERCOM1
    config ATSAMD_SERIAL_SERCOM1_TX_A30
        bool "TX on A30" if ATSAMD_SERIAL_SERCOM1
    config ATSAMD_SERIAL_SERCOM2_TX_A12
        bool "TX on A12" if ATSAMD_SERIAL_SERCOM2
    config ATSAMD_SERIAL_SERCOM2_TX_A14
        bool "TX on A14" if ATSAMD_SERIAL_SERCOM2
    config ATSAMD_SERIAL_SERCOM2_TX_A8
        bool "TX on A8" if ATSAMD_SERIAL_SERCOM2
    config ATSAMD_SERIAL_SERCOM2_TX_A10
        bool "TX on A10" if ATSAMD_SERIAL_SERCOM2
    config ATSAMD_SERIAL_SERCOM3_TX_A22
        bool "TX on A22" if ATSAMD_SERIAL_SERCOM3
    config ATSAMD_SERIAL_SERCOM3_TX_A24
        bool "TX on A24" if ATSAMD_SERIAL_SERCOM3
    config ATSAMD_SERIAL_SERCOM3_TX_A16
        bool "TX on A16" if ATSAMD_SERIAL_SERCOM3
    config ATSAMD_SERIAL_SERCOM3_TX_A18
        bool "TX on A18" if ATSAMD_SERIAL_SERCOM3
    config ATSAMD_SERIAL_SERCOM3_TX_A20
        bool "TX on A20" if ATSAMD_SERIAL_SERCOM3
    config ATSAMD_SERIAL_SERCOM4_TX_B12
        bool "TX on B12" if ATSAMD_SERIAL_SERCOM4
    config ATSAMD_SERIAL_SERCOM4_TX_B14
        bool "TX on B14" if ATSAMD_SERIAL_SERCOM4
    config ATSAMD_SERIAL_SERCOM4_TX_B8
        bool "TX on B8" if ATSAMD_SERIAL_SERCOM4
    config ATSAMD_SERIAL_SERCOM4_TX_B10
        bool "TX on B10" if ATSAMD_SERIAL_SERCOM4
    config ATSAMD_SERIAL_SERCOM4_TX_A12
        bool "TX on A12" if ATSAMD_SERIAL_SERCOM4
    config ATSAMD_SERIAL_SERCOM4_TX_A14
        bool "TX on A14" if ATSAMD_SERIAL_SERCOM4
    config ATSAMD_SERIAL_SERCOM5_TX_B16
        bool "TX on B16" if ATSAMD_SERIAL_SERCOM5
    config ATSAMD_SERIAL_SERCOM5_TX_A20
        bool "TX on A20" if ATSAMD_SERIAL_SERCOM5
    config ATSAMD_SERIAL_SERCOM5_TX_A22
        bool "TX on A22" if ATSAMD_SERIAL_SERCOM5
    config ATSAMD_SERIAL_SERCOM5_TX_A24
        bool "TX on A24" if ATSAMD_SERIAL_SERCOM5
    config ATSAMD_SERIAL_SERCOM5_TX_B30
        bool "TX on B30" if ATSAMD_SERIAL_SERCOM5
    config ATSAMD_SERIAL_SERCOM5_TX_B22
        bool "TX on B22" if ATSAMD_SERIAL_SERCOM5
    config ATSAMD_SERIAL_SERCOM5_TX_B2
        bool "TX on B2" if ATSAMD_SERIAL_SERCOM5
    config ATSAMD_SERIAL_SERCOM5_TX_B0
        bool "TX on B0" if ATSAMD_SERIAL_SERCOM5
    endif
    if MACH_SAMX5
    config ATSAMD_SERIAL_SERCOM0_TX_A8
        bool "TX on A8" if ATSAMD_SERIAL_SERCOM0
    config ATSAMD_SERIAL_SERCOM0_TX_B24
        bool "TX on B24" if ATSAMD_SERIAL_SERCOM0
    config ATSAMD_SERIAL_SERCOM0_TX_A4
        bool "TX on A4" if ATSAMD_SERIAL_SERCOM0
    config ATSAMD_SERIAL_SERCOM0_TX_C17
        bool "TX on C17" if ATSAMD_SERIAL_SERCOM0
    config ATSAMD_SERIAL_SERCOM1_TX_A16
        bool "TX on A16" if ATSAMD_SERIAL_SERCOM1
    config ATSAMD_SERIAL_SERCOM1_TX_C22
        bool "TX on C22" if ATSAMD_SERIAL_SERCOM1
    config ATSAMD_SERIAL_SERCOM1_TX_C27
        bool "TX on C27" if ATSAMD_SERIAL_SERCOM1
    config ATSAMD_SERIAL_SERCOM1_TX_A0
        bool "TX on A0" if ATSAMD_SERIAL_SERCOM1
    config ATSAMD_SERIAL_SERCOM2_TX_A12
        bool "TX on A12" if ATSAMD_SERIAL_SERCOM2
    config ATSAMD_SERIAL_SERCOM2_TX_B26
        bool "TX on B26" if ATSAMD_SERIAL_SERCOM2
    config ATSAMD_SERIAL_SERCOM2_TX_A9
        bool "TX on A9" if ATSAMD_SERIAL_SERCOM2
    config ATSAMD_SERIAL_SERCOM2_TX_B25
        bool "TX on B25" if ATSAMD_SERIAL_SERCOM2
    config ATSAMD_SERIAL_SERCOM3_TX_A22
        bool "TX on A22" if ATSAMD_SERIAL_SERCOM3
    config ATSAMD_SERIAL_SERCOM3_TX_B20
        bool "TX on B20" if ATSAMD_SERIAL_SERCOM3
    config ATSAMD_SERIAL_SERCOM3_TX_A17
        bool "TX on A17" if ATSAMD_SERIAL_SERCOM3
    config ATSAMD_SERIAL_SERCOM3_TX_C23
        bool "TX on C23" if ATSAMD_SERIAL_SERCOM3
    config ATSAMD_SERIAL_SERCOM4_TX_B12
        bool "TX on B12" if ATSAMD_SERIAL_SERCOM4
    config ATSAMD_SERIAL_SERCOM4_TX_B8
        bool "TX on B8" if ATSAMD_SERIAL_SERCOM4
    config ATSAMD_SERIAL_SERCOM4_TX_A13
        bool "TX on A13" if ATSAMD_SERIAL_SERCOM4
    config ATSAMD_SERIAL_SERCOM4_TX_B27
        bool "TX on B27" if ATSAMD_SERIAL_SERCOM4
    config ATSAMD_SERIAL_SERCOM5_TX_B16
        bool "TX on B16" if ATSAMD_SERIAL_SERCOM5
    config ATSAMD_SERIAL_SERCOM5_TX_A23
        bool "TX on A23" if ATSAMD_SERIAL_SERCOM5
    config ATSAMD_SERIAL_SERCOM5_TX_B31
        bool "TX on B31" if ATSAMD_SERIAL_SERCOM5
    config ATSAMD_SERIAL_SERCOM5_TX_B2
        bool "TX on B2" if ATSAMD_SERIAL_SERCOM5
    config ATSAMD_SERIAL_SERCOM6_TX_C16
        bool "TX on C16" if ATSAMD_SERIAL_SERCOM6
    config ATSAMD_SERIAL_SERCOM6_TX_C4
        bool "TX on C4" if ATSAMD_SERIAL_SERCOM6
    config ATSAMD_SERIAL_SERCOM6_TX_D9
        bool "TX on D9" if ATSAMD_SERIAL_SERCOM6
    config ATSAMD_SERIAL_SERCOM6_TX_C13
        bool "TX on C13" if ATSAMD_SERIAL_SERCOM6
    config ATSAMD_SERIAL_SERCOM7_TX_C12
        bool "TX on C12" if ATSAMD_SERIAL_SERCOM7
    config ATSAMD_SERIAL_SERCOM7_TX_D8
        bool "TX on D8" if ATSAMD_SERIAL_SERCOM7
    config ATSAMD_SERIAL_SERCOM7_TX_B21
        bool "TX on B21" if ATSAMD_SERIAL_SERCOM7
    config ATSAMD_SERIAL_SERCOM7_TX_B30
        bool "TX on B30" if ATSAMD_SERIAL_SERCOM7
    endif
endchoice

choice
    prompt "Serial RX Pin" if LOW_LEVEL_OPTIONS && SERIAL
    default ATSAMD_SERIAL_SERCOM0_RX_A11 if ATSAMD_SERIAL_SERCOM0
    default ATSAMD_SERIAL_SERCOM3_RX_A16 if ATSAMD_SERIAL_SERCOM3
    default ATSAMD_SERIAL_SERCOM5_RX_B17 if ATSAMD_SERIAL_SERCOM5
    if MACH_SAMD21 
    config ATSAMD_SERIAL_SERCOM0_RX_A8
        bool "RX on A8" if ATSAMD_SERIAL_SERCOM0 && !ATSAMD_SERIAL_SERCOM0_TX_A8
    config ATSAMD_SERIAL_SERCOM0_RX_A9
        bool "RX on A9" if ATSAMD_SERIAL_SERCOM0
    config ATSAMD_SERIAL_SERCOM0_RX_A10
        bool "RX on A10" if ATSAMD_SERIAL_SERCOM0 && !ATSAMD_SERIAL_SERCOM0_TX_A10
    config ATSAMD_SERIAL_SERCOM0_RX_A11
        bool "RX on A11" if ATSAMD_SERIAL_SERCOM0
    config ATSAMD_SERIAL_SERCOM0_RX_A4
        bool "RX on A4" if ATSAMD_SERIAL_SERCOM0 && !ATSAMD_SERIAL_SERCOM0_TX_A4
    config ATSAMD_SERIAL_SERCOM0_RX_A5
        bool "RX on A5" if ATSAMD_SERIAL_SERCOM0
    config ATSAMD_SERIAL_SERCOM0_RX_A6
        bool "RX on A6" if ATSAMD_SERIAL_SERCOM0 && !ATSAMD_SERIAL_SERCOM0_TX_A6
    config ATSAMD_SERIAL_SERCOM0_RX_A7
        bool "RX on A7" if ATSAMD_SERIAL_SERCOM0
    config ATSAMD_SERIAL_SERCOM1_RX_A16
        bool "RX on A16" if ATSAMD_SERIAL_SERCOM1 && !ATSAMD_SERIAL_SERCOM1_TX_A16
    config ATSAMD_SERIAL_SERCOM1_RX_A17
        bool "RX on A17" if ATSAMD_SERIAL_SERCOM1
    config ATSAMD_SERIAL_SERCOM1_RX_A18
        bool "RX on A18" if ATSAMD_SERIAL_SERCOM1 && !ATSAMD_SERIAL_SERCOM1_TX_A18
    config ATSAMD_SERIAL_SERCOM1_RX_A19
        bool "RX on A19" if ATSAMD_SERIAL_SERCOM1
    config ATSAMD_SERIAL_SERCOM1_RX_A0
        bool "RX on A0" if ATSAMD_SERIAL_SERCOM1 && !ATSAMD_SERIAL_SERCOM1_TX_A0
    config ATSAMD_SERIAL_SERCOM1_RX_A1
        bool "RX on A1" if ATSAMD_SERIAL_SERCOM1
    config ATSAMD_SERIAL_SERCOM1_RX_A30
        bool "RX on A30" if ATSAMD_SERIAL_SERCOM1 && !ATSAMD_SERIAL_SERCOM1_TX_A30
    config ATSAMD_SERIAL_SERCOM1_RX_A31
        bool "RX on A31" if ATSAMD_SERIAL_SERCOM1
    config ATSAMD_SERIAL_SERCOM2_RX_A12
        bool "RX on A12" if ATSAMD_SERIAL_SERCOM2 && !ATSAMD_SERIAL_SERCOM2_TX_A12
    config ATSAMD_SERIAL_SERCOM2_RX_A13
        bool "RX on A13" if ATSAMD_SERIAL_SERCOM2
    config ATSAMD_SERIAL_SERCOM2_RX_A14
        bool "RX on A14" if ATSAMD_SERIAL_SERCOM2 && !ATSAMD_SERIAL_SERCOM2_TX_A14
    config ATSAMD_SERIAL_SERCOM2_RX_A15
        bool "RX on A15" if ATSAMD_SERIAL_SERCOM2
    config ATSAMD_SERIAL_SERCOM2_RX_A8
        bool "RX on A8" if ATSAMD_SERIAL_SERCOM2 && !ATSAMD_SERIAL_SERCOM2_TX_A8
    config ATSAMD_SERIAL_SERCOM2_RX_A9
        bool "RX on A9" if ATSAMD_SERIAL_SERCOM2
    config ATSAMD_SERIAL_SERCOM2_RX_A10
        bool "RX on A10" if ATSAMD_SERIAL_SERCOM2 && !ATSAMD_SERIAL_SERCOM2_TX_A10
    config ATSAMD_SERIAL_SERCOM2_RX_A11
        bool "RX on A11" if ATSAMD_SERIAL_SERCOM2
    config ATSAMD_SERIAL_SERCOM3_RX_A22
        bool "RX on A22" if ATSAMD_SERIAL_SERCOM3 && !ATSAMD_SERIAL_SERCOM3_TX_A22
    config ATSAMD_SERIAL_SERCOM3_RX_A23
        bool "RX on A23" if ATSAMD_SERIAL_SERCOM3
    config ATSAMD_SERIAL_SERCOM3_RX_A24
        bool "RX on A24" if ATSAMD_SERIAL_SERCOM3 && !ATSAMD_SERIAL_SERCOM3_TX_A24
    config ATSAMD_SERIAL_SERCOM3_RX_A25
        bool "RX on A25" if ATSAMD_SERIAL_SERCOM3
    config ATSAMD_SERIAL_SERCOM3_RX_A16
        bool "RX on A16" if ATSAMD_SERIAL_SERCOM3 && !ATSAMD_SERIAL_SERCOM3_TX_A16
    config ATSAMD_SERIAL_SERCOM3_RX_A17
        bool "RX on A17" if ATSAMD_SERIAL_SERCOM3
    config ATSAMD_SERIAL_SERCOM3_RX_A18
        bool "RX on A18" if ATSAMD_SERIAL_SERCOM3 && !ATSAMD_SERIAL_SERCOM3_TX_A18
    config ATSAMD_SERIAL_SERCOM3_RX_A19
        bool "RX on A19" if ATSAMD_SERIAL_SERCOM3
    config ATSAMD_SERIAL_SERCOM3_RX_A20
        bool "RX on A20" if ATSAMD_SERIAL_SERCOM3 && !ATSAMD_SERIAL_SERCOM3_TX_A20
    config ATSAMD_SERIAL_SERCOM3_RX_A21
        bool "RX on A21" if ATSAMD_SERIAL_SERCOM3
    config ATSAMD_SERIAL_SERCOM4_RX_B12
        bool "RX on B12" if ATSAMD_SERIAL_SERCOM4 && !ATSAMD_SERIAL_SERCOM4_TX_B12
    config ATSAMD_SERIAL_SERCOM4_RX_B13
        bool "RX on B13" if ATSAMD_SERIAL_SERCOM4
    config ATSAMD_SERIAL_SERCOM4_RX_B14
        bool "RX on B14" if ATSAMD_SERIAL_SERCOM4 && !ATSAMD_SERIAL_SERCOM4_TX_B14
    config ATSAMD_SERIAL_SERCOM4_RX_B15
        bool "RX on B15" if ATSAMD_SERIAL_SERCOM4
    config ATSAMD_SERIAL_SERCOM4_RX_B8
        bool "RX on B8" if ATSAMD_SERIAL_SERCOM4 && !ATSAMD_SERIAL_SERCOM4_TX_B8
    config ATSAMD_SERIAL_SERCOM4_RX_B9
        bool "RX on B9" if ATSAMD_SERIAL_SERCOM4
    config ATSAMD_SERIAL_SERCOM4_RX_B10
        bool "RX on B10" if ATSAMD_SERIAL_SERCOM4 && !ATSAMD_SERIAL_SERCOM4_TX_B10
    config ATSAMD_SERIAL_SERCOM4_RX_B11
        bool "RX on B11" if ATSAMD_SERIAL_SERCOM4
    config ATSAMD_SERIAL_SERCOM4_RX_A12
        bool "RX on A12" if ATSAMD_SERIAL_SERCOM4 && !ATSAMD_SERIAL_SERCOM4_TX_A12
    config ATSAMD_SERIAL_SERCOM4_RX_A13
        bool "RX on A13" if ATSAMD_SERIAL_SERCOM4
    config ATSAMD_SERIAL_SERCOM4_RX_A14
        bool "RX on A14" if ATSAMD_SERIAL_SERCOM4 && !ATSAMD_SERIAL_SERCOM4_TX_A14
    config ATSAMD_SERIAL_SERCOM4_RX_A15
        bool "RX on A15" if ATSAMD_SERIAL_SERCOM4
    config ATSAMD_SERIAL_SERCOM5_RX_B16
        bool "RX on B16" if ATSAMD_SERIAL_SERCOM5 && !ATSAMD_SERIAL_SERCOM5_TX_B16
    config ATSAMD_SERIAL_SERCOM5_RX_B17
        bool "RX on B17" if ATSAMD_SERIAL_SERCOM5
    config ATSAMD_SERIAL_SERCOM5_RX_A20
        bool "RX on A20" if ATSAMD_SERIAL_SERCOM5 && !ATSAMD_SERIAL_SERCOM5_TX_A20
    config ATSAMD_SERIAL_SERCOM5_RX_A21
        bool "RX on A21" if ATSAMD_SERIAL_SERCOM5
    config ATSAMD_SERIAL_SERCOM5_RX_A22
        bool "RX on A22" if ATSAMD_SERIAL_SERCOM5 && !ATSAMD_SERIAL_SERCOM5_TX_A22
    config ATSAMD_SERIAL_SERCOM5_RX_A23
        bool "RX on A23" if ATSAMD_SERIAL_SERCOM5
    config ATSAMD_SERIAL_SERCOM5_RX_A24
        bool "RX on A24" if ATSAMD_SERIAL_SERCOM5 && !ATSAMD_SERIAL_SERCOM5_TX_A24
    config ATSAMD_SERIAL_SERCOM5_RX_A25
        bool "RX on A25" if ATSAMD_SERIAL_SERCOM5
    config ATSAMD_SERIAL_SERCOM5_RX_B30
        bool "RX on B30" if ATSAMD_SERIAL_SERCOM5 && !ATSAMD_SERIAL_SERCOM5_TX_B30
    config ATSAMD_SERIAL_SERCOM5_RX_B31
        bool "RX on B31" if ATSAMD_SERIAL_SERCOM5
    config ATSAMD_SERIAL_SERCOM5_RX_B22
        bool "RX on B22" if ATSAMD_SERIAL_SERCOM5 && !ATSAMD_SERIAL_SERCOM5_TX_B22
    config ATSAMD_SERIAL_SERCOM5_RX_B23
        bool "RX on B23" if ATSAMD_SERIAL_SERCOM5
    config ATSAMD_SERIAL_SERCOM5_RX_B2
        bool "RX on B2" if ATSAMD_SERIAL_SERCOM5 && !ATSAMD_SERIAL_SERCOM5_TX_B2
    config ATSAMD_SERIAL_SERCOM5_RX_B3
        bool "RX on B3" if ATSAMD_SERIAL_SERCOM5
    config ATSAMD_SERIAL_SERCOM5_RX_B0
        bool "RX on B0" if ATSAMD_SERIAL_SERCOM5 && !ATSAMD_SERIAL_SERCOM5_TX_B0
    config ATSAMD_SERIAL_SERCOM5_RX_B1
        bool "RX on B1" if ATSAMD_SERIAL_SERCOM5
    endif
    if MACH_SAMX5
    config ATSAMD_SERIAL_SERCOM0_RX_A9
        bool "RX on A9" if ATSAMD_SERIAL_SERCOM0
    config ATSAMD_SERIAL_SERCOM0_RX_A10
        bool "RX on A10" if ATSAMD_SERIAL_SERCOM0
    config ATSAMD_SERIAL_SERCOM0_RX_A11
        bool "RX on A11" if ATSAMD_SERIAL_SERCOM0
    config ATSAMD_SERIAL_SERCOM0_RX_B25
        bool "RX on B25" if ATSAMD_SERIAL_SERCOM0
    config ATSAMD_SERIAL_SERCOM0_RX_C24
        bool "RX on C24" if ATSAMD_SERIAL_SERCOM0
    config ATSAMD_SERIAL_SERCOM0_RX_C25
        bool "RX on C25" if ATSAMD_SERIAL_SERCOM0
    config ATSAMD_SERIAL_SERCOM0_RX_A5
        bool "RX on A5" if ATSAMD_SERIAL_SERCOM0
    config ATSAMD_SERIAL_SERCOM0_RX_A6
        bool "RX on A6" if ATSAMD_SERIAL_SERCOM0
    config ATSAMD_SERIAL_SERCOM0_RX_A7
        bool "RX on A7" if ATSAMD_SERIAL_SERCOM0
    config ATSAMD_SERIAL_SERCOM0_RX_C16
        bool "RX on C16" if ATSAMD_SERIAL_SERCOM0
    config ATSAMD_SERIAL_SERCOM0_RX_C18
        bool "RX on C18" if ATSAMD_SERIAL_SERCOM0
    config ATSAMD_SERIAL_SERCOM0_RX_C19
        bool "RX on C19" if ATSAMD_SERIAL_SERCOM0
    config ATSAMD_SERIAL_SERCOM1_RX_A17
        bool "RX on A17" if ATSAMD_SERIAL_SERCOM1
    config ATSAMD_SERIAL_SERCOM1_RX_A18
        bool "RX on A18" if ATSAMD_SERIAL_SERCOM1
    config ATSAMD_SERIAL_SERCOM1_RX_A19
        bool "RX on A19" if ATSAMD_SERIAL_SERCOM1
    config ATSAMD_SERIAL_SERCOM1_RX_C23
        bool "RX on C23" if ATSAMD_SERIAL_SERCOM1
    config ATSAMD_SERIAL_SERCOM1_RX_D20
        bool "RX on D20" if ATSAMD_SERIAL_SERCOM1
    config ATSAMD_SERIAL_SERCOM1_RX_D21
        bool "RX on D21" if ATSAMD_SERIAL_SERCOM1
    config ATSAMD_SERIAL_SERCOM1_RX_C28
        bool "RX on C28" if ATSAMD_SERIAL_SERCOM1
    config ATSAMD_SERIAL_SERCOM1_RX_B22
        bool "RX on B22" if ATSAMD_SERIAL_SERCOM1
    config ATSAMD_SERIAL_SERCOM1_RX_B23
        bool "RX on B23" if ATSAMD_SERIAL_SERCOM1
    config ATSAMD_SERIAL_SERCOM1_RX_A1
        bool "RX on A1" if ATSAMD_SERIAL_SERCOM1
    config ATSAMD_SERIAL_SERCOM1_RX_A30
        bool "RX on A30" if ATSAMD_SERIAL_SERCOM1
    config ATSAMD_SERIAL_SERCOM1_RX_A31
        bool "RX on A31" if ATSAMD_SERIAL_SERCOM1
    config ATSAMD_SERIAL_SERCOM2_RX_A13
        bool "RX on A13" if ATSAMD_SERIAL_SERCOM2
    config ATSAMD_SERIAL_SERCOM2_RX_A14
        bool "RX on A14" if ATSAMD_SERIAL_SERCOM2
    config ATSAMD_SERIAL_SERCOM2_RX_A15
        bool "RX on A15" if ATSAMD_SERIAL_SERCOM2
    config ATSAMD_SERIAL_SERCOM2_RX_B27
        bool "RX on B27" if ATSAMD_SERIAL_SERCOM2
    config ATSAMD_SERIAL_SERCOM2_RX_B28
        bool "RX on B28" if ATSAMD_SERIAL_SERCOM2
    config ATSAMD_SERIAL_SERCOM2_RX_B29
        bool "RX on B29" if ATSAMD_SERIAL_SERCOM2
    config ATSAMD_SERIAL_SERCOM2_RX_A8
        bool "RX on A8" if ATSAMD_SERIAL_SERCOM2
    config ATSAMD_SERIAL_SERCOM2_RX_A10
        bool "RX on A10" if ATSAMD_SERIAL_SERCOM2
    config ATSAMD_SERIAL_SERCOM2_RX_A11
        bool "RX on A11" if ATSAMD_SERIAL_SERCOM2
    config ATSAMD_SERIAL_SERCOM2_RX_B24
        bool "RX on B24" if ATSAMD_SERIAL_SERCOM2
    config ATSAMD_SERIAL_SERCOM2_RX_C24
        bool "RX on C24" if ATSAMD_SERIAL_SERCOM2
    config ATSAMD_SERIAL_SERCOM2_RX_C25
        bool "RX on C25" if ATSAMD_SERIAL_SERCOM2
    config ATSAMD_SERIAL_SERCOM3_RX_A23
        bool "RX on A23" if ATSAMD_SERIAL_SERCOM3
    config ATSAMD_SERIAL_SERCOM3_RX_A24
        bool "RX on A24" if ATSAMD_SERIAL_SERCOM3
    config ATSAMD_SERIAL_SERCOM3_RX_A25
        bool "RX on A25" if ATSAMD_SERIAL_SERCOM3
    config ATSAMD_SERIAL_SERCOM3_RX_B21
        bool "RX on B21" if ATSAMD_SERIAL_SERCOM3
    config ATSAMD_SERIAL_SERCOM3_RX_A20
        bool "RX on A20" if ATSAMD_SERIAL_SERCOM3
    config ATSAMD_SERIAL_SERCOM3_RX_A21
        bool "RX on A21" if ATSAMD_SERIAL_SERCOM3
    config ATSAMD_SERIAL_SERCOM3_RX_A16
        bool "RX on A16" if ATSAMD_SERIAL_SERCOM3
    config ATSAMD_SERIAL_SERCOM3_RX_A18
        bool "RX on A18" if ATSAMD_SERIAL_SERCOM3
    config ATSAMD_SERIAL_SERCOM3_RX_A19
        bool "RX on A19" if ATSAMD_SERIAL_SERCOM3
    config ATSAMD_SERIAL_SERCOM3_RX_C22
        bool "RX on C22" if ATSAMD_SERIAL_SERCOM3
    config ATSAMD_SERIAL_SERCOM3_RX_D20
        bool "RX on D20" if ATSAMD_SERIAL_SERCOM3
    config ATSAMD_SERIAL_SERCOM3_RX_D21
        bool "RX on D21" if ATSAMD_SERIAL_SERCOM3
    config ATSAMD_SERIAL_SERCOM4_RX_B13
        bool "RX on B13" if ATSAMD_SERIAL_SERCOM4
    config ATSAMD_SERIAL_SERCOM4_RX_B14
        bool "RX on B14" if ATSAMD_SERIAL_SERCOM4
    config ATSAMD_SERIAL_SERCOM4_RX_B15
        bool "RX on B15" if ATSAMD_SERIAL_SERCOM4
    config ATSAMD_SERIAL_SERCOM4_RX_B9
        bool "RX on B9" if ATSAMD_SERIAL_SERCOM4
    config ATSAMD_SERIAL_SERCOM4_RX_B10
        bool "RX on B10" if ATSAMD_SERIAL_SERCOM4
    config ATSAMD_SERIAL_SERCOM4_RX_B11
        bool "RX on B11" if ATSAMD_SERIAL_SERCOM4
    config ATSAMD_SERIAL_SERCOM4_RX_A12
        bool "RX on A12" if ATSAMD_SERIAL_SERCOM4
    config ATSAMD_SERIAL_SERCOM4_RX_A14
        bool "RX on A14" if ATSAMD_SERIAL_SERCOM4
    config ATSAMD_SERIAL_SERCOM4_RX_A15
        bool "RX on A15" if ATSAMD_SERIAL_SERCOM4
    config ATSAMD_SERIAL_SERCOM4_RX_B26
        bool "RX on B26" if ATSAMD_SERIAL_SERCOM4
    config ATSAMD_SERIAL_SERCOM4_RX_B28
        bool "RX on B28" if ATSAMD_SERIAL_SERCOM4
    config ATSAMD_SERIAL_SERCOM4_RX_B29
        bool "RX on B29" if ATSAMD_SERIAL_SERCOM4
    config ATSAMD_SERIAL_SERCOM5_RX_B17
        bool "RX on B17" if ATSAMD_SERIAL_SERCOM5
    config ATSAMD_SERIAL_SERCOM5_RX_B18
        bool "RX on B18" if ATSAMD_SERIAL_SERCOM5
    config ATSAMD_SERIAL_SERCOM5_RX_B19
        bool "RX on B19" if ATSAMD_SERIAL_SERCOM5
    config ATSAMD_SERIAL_SERCOM5_RX_A22
        bool "RX on A22" if ATSAMD_SERIAL_SERCOM5
    config ATSAMD_SERIAL_SERCOM5_RX_A20
        bool "RX on A20" if ATSAMD_SERIAL_SERCOM5
    config ATSAMD_SERIAL_SERCOM5_RX_A21
        bool "RX on A21" if ATSAMD_SERIAL_SERCOM5
    config ATSAMD_SERIAL_SERCOM5_RX_A24
        bool "RX on A24" if ATSAMD_SERIAL_SERCOM5
    config ATSAMD_SERIAL_SERCOM5_RX_A25
        bool "RX on A25" if ATSAMD_SERIAL_SERCOM5
    config ATSAMD_SERIAL_SERCOM5_RX_B22
        bool "RX on B22" if ATSAMD_SERIAL_SERCOM5
    config ATSAMD_SERIAL_SERCOM5_RX_B23
        bool "RX on B23" if ATSAMD_SERIAL_SERCOM5
    config ATSAMD_SERIAL_SERCOM5_RX_B30
        bool "RX on B30" if ATSAMD_SERIAL_SERCOM5
    config ATSAMD_SERIAL_SERCOM5_RX_B0
        bool "RX on B0" if ATSAMD_SERIAL_SERCOM5
    config ATSAMD_SERIAL_SERCOM5_RX_B1
        bool "RX on B1" if ATSAMD_SERIAL_SERCOM5
    config ATSAMD_SERIAL_SERCOM5_RX_B3
        bool "RX on B3" if ATSAMD_SERIAL_SERCOM5
    config ATSAMD_SERIAL_SERCOM6_RX_C17
        bool "RX on C17" if ATSAMD_SERIAL_SERCOM6
    config ATSAMD_SERIAL_SERCOM6_RX_C18
        bool "RX on C18" if ATSAMD_SERIAL_SERCOM6
    config ATSAMD_SERIAL_SERCOM6_RX_C19
        bool "RX on C19" if ATSAMD_SERIAL_SERCOM6
    config ATSAMD_SERIAL_SERCOM6_RX_C5
        bool "RX on C5" if ATSAMD_SERIAL_SERCOM6
    config ATSAMD_SERIAL_SERCOM6_RX_C6
        bool "RX on C6" if ATSAMD_SERIAL_SERCOM6
    config ATSAMD_SERIAL_SERCOM6_RX_C7
        bool "RX on C7" if ATSAMD_SERIAL_SERCOM6
    config ATSAMD_SERIAL_SERCOM6_RX_D8
        bool "RX on D8" if ATSAMD_SERIAL_SERCOM6
    config ATSAMD_SERIAL_SERCOM6_RX_D10
        bool "RX on D10" if ATSAMD_SERIAL_SERCOM6
    config ATSAMD_SERIAL_SERCOM6_RX_D11
        bool "RX on D11" if ATSAMD_SERIAL_SERCOM6
    config ATSAMD_SERIAL_SERCOM6_RX_C12
        bool "RX on C12" if ATSAMD_SERIAL_SERCOM6
    config ATSAMD_SERIAL_SERCOM6_RX_C14
        bool "RX on C14" if ATSAMD_SERIAL_SERCOM6
    config ATSAMD_SERIAL_SERCOM6_RX_C15
        bool "RX on C15" if ATSAMD_SERIAL_SERCOM6
    config ATSAMD_SERIAL_SERCOM6_RX_C10
        bool "RX on C10" if ATSAMD_SERIAL_SERCOM6
    config ATSAMD_SERIAL_SERCOM6_RX_C11
        bool "RX on C11" if ATSAMD_SERIAL_SERCOM6
    config ATSAMD_SERIAL_SERCOM7_RX_C13
        bool "RX on C13" if ATSAMD_SERIAL_SERCOM7
    config ATSAMD_SERIAL_SERCOM7_RX_C14
        bool "RX on C14" if ATSAMD_SERIAL_SERCOM7
    config ATSAMD_SERIAL_SERCOM7_RX_C15
        bool "RX on C15" if ATSAMD_SERIAL_SERCOM7
    config ATSAMD_SERIAL_SERCOM7_RX_D9
        bool "RX on D9" if ATSAMD_SERIAL_SERCOM7
    config ATSAMD_SERIAL_SERCOM7_RX_D10
        bool "RX on D10" if ATSAMD_SERIAL_SERCOM7
    config ATSAMD_SERIAL_SERCOM7_RX_D11
        bool "RX on D11" if ATSAMD_SERIAL_SERCOM7
    config ATSAMD_SERIAL_SERCOM7_RX_C10
        bool "RX on C10" if ATSAMD_SERIAL_SERCOM7
    config ATSAMD_SERIAL_SERCOM7_RX_C11
        bool "RX on C11" if ATSAMD_SERIAL_SERCOM7
    config ATSAMD_SERIAL_SERCOM7_RX_B20
        bool "RX on B20" if ATSAMD_SERIAL_SERCOM7
    config ATSAMD_SERIAL_SERCOM7_RX_B18
        bool "RX on B18" if ATSAMD_SERIAL_SERCOM7
    config ATSAMD_SERIAL_SERCOM7_RX_B19
        bool "RX on B19" if ATSAMD_SERIAL_SERCOM7
    config ATSAMD_SERIAL_SERCOM7_RX_B31
        bool "RX on B31" if ATSAMD_SERIAL_SERCOM7
    config ATSAMD_SERIAL_SERCOM7_RX_A30
        bool "RX on A30" if ATSAMD_SERIAL_SERCOM7
    config ATSAMD_SERIAL_SERCOM7_RX_A31
        bool "RX on A31" if ATSAMD_SERIAL_SERCOM7
    endif
endchoice

choice
    prompt "CAN bus interface" if USBCANBUS
    config ATSAMD_CMENU_CANBUS_PA23_PA22
        bool "CAN bus (on PA23/PA22)"
    config ATSAMD_CMENU_CANBUS_PB13_PB12
        bool "CAN bus (on PB13/PB12)"
    config ATSAMD_CMENU_CANBUS_PB15_PB14
        bool "CAN bus (on PB15/PB14)"
endchoice

config ATSAMD_CANBUS_PA23_PA22
    bool
    default y if ATSAMD_MMENU_CANBUS_PA23_PA22 || ATSAMD_CMENU_CANBUS_PA23_PA22
config ATSAMD_CANBUS_PA25_PA24
    bool
    default y if ATSAMD_MMENU_CANBUS_PA25_PA24
config ATSAMD_CANBUS_PB11_PB10
    bool
    default y if ATSAMD_MMENU_CANBUS_PB11_PB10
config ATSAMD_CANBUS_PB13_PB12
    bool
    default y if ATSAMD_MMENU_CANBUS_PB13_PB12 || ATSAMD_CMENU_CANBUS_PB13_PB12
config ATSAMD_CANBUS_PB15_PB14
    bool
    default y if ATSAMD_MMENU_CANBUS_PB15_PB14 || ATSAMD_CMENU_CANBUS_PB15_PB14

endif
```
